## src/drivers/gps_fake/Kconfig
```kconfig
menu "Gps fake"
    menuconfig COMMON_GPS_FAKE
        bool "Common gps fake module's"
        default n
        select DRIVERS_GPS_FAKE_DWM1004C
        ---help---
            Enable default set of gps fake drivers
    rsource "*/Kconfig"
endmenu
```

## src/drivers/gps_fake/dwm1004c/Kconfig
```kconfig
menuconfig DRIVERS_GPS_FAKE_DWM1004C
	bool "dwm1004c"
	default n
	---help---
		Enable support for dwm1004c
```

## src/examples/fake_gps_uwb/Kconfig
```kconfig
menuconfig EXAMPLES_FAKE_GPS_UWB
	bool "fake_gps_uwb"
	default n
	---help---
		Enable support for fake_gps_uwb
```
